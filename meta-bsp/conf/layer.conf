## meta-bsp/conf/layer.conf
```bitbake
BBPATH := "${BBPATH}:${LAYERDIR}"

BBFILES := "${BBFILES} \
    ${LAYERDIR}/recipes-*/*.bb \
    ${LAYERDIR}/recipes-*/*.bbappend \
    ${LAYERDIR}/recipes-*/*/*.bb \
    ${LAYERDIR}/recipes-*/*/*.bbappend \
    ${LAYERDIR}/recipes-*/*/*/*.bb \
    ${LAYERDIR}/recipes-*/*/*/*.bbappend \
"

# The dynamic-layers directory hosts the extensions and layer specific
# modifications.
#
# The .bbappend and .bb files are included if the respective layer
# collection is available.
BBFILES_DYNAMIC += " \
    lts-u-boot-mixin:${LAYERDIR}/dynamic-layers/meta-lts-mixins-uboot/*/*/*.bb \
    lts-u-boot-mixin:${LAYERDIR}/dynamic-layers/meta-lts-mixins-uboot/*/*/*.bbappend \
"

BBFILE_COLLECTIONS += "victronenergy-bsp"
BBFILE_PATTERN_victronenergy-bsp := "^${LAYERDIR}/"
BBFILE_PRIORITY_victronenergy-bsp = "5"
LAYERSERIES_COMPAT_victronenergy-bsp = "scarthgap"
```
